## examples/uorb_demo/Kconfig
```kconfig
#
# For a description of the syntax of this configuration file,
# see the file kconfig-language.txt in the NuttX tools repository.
#

config UORB_DEMO
	tristate "uorb_demo"
	default n
	depends on HAVE_CXX
	---help---
		Enable the uorb demo
```

## middleware/hello_andres/Kconfig
```kconfig
#
# For a description of the syntax of this configuration file,
# see the file kconfig-language.txt in the NuttX tools repository.
#

config HELLO_ANDRES
	tristate "Hello andres program"
	default n
	---help---
		Enable the hello andres prog

if HELLO_ANDRES

config HELLO_ANDRES_PROGNAME
	string "Program name"
	default "hello"
	---help---
		This is the name of the program that will be used when the NSH ELF
		program is installed.

config HELLO_ANDRES_PRIORITY
	int "Hello task priority"
	default 100

config HELLO_ANDRES_STACKSIZE
	int "Hello stack size"
	default DEFAULT_TASK_STACKSIZE

endif
```

## middleware/uorb/Kconfig
```kconfig
#
# For a description of the syntax of this configuration file,
# see the file kconfig-language.txt in the NuttX tools repository.
#


config UORB
	tristate "uORB"
	default n
	---help---
		Enable the uORB 

if UORB

config UORB_PROGNAME
	string "Program name"
	default "uorb"
	---help---
		This is the name of the program that will be used when the NSH ELF
		program is installed.

config UORB_PRIORITY
	int "uORB task priority"
	default 100

config UORB_STACKSIZE
	int "uORB stack size"
	default DEFAULT_TASK_STACKSIZE

endif
```
